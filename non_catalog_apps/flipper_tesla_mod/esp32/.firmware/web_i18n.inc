// web_i18n.inc — GENERATED by esp32/gen_i18n.py. DO NOT EDIT.
// Chinese (Simplified + Traditional) translation layer for the ESP32 web
// dashboard. Included by web_dashboard.cpp between the page's raw string
// literals (NOT inside a macro — xtensa GCC 8.4 can't do multi-line raw
// strings in #define).
R"rawliteral(
<script>
(function(){
"use strict";
/* English UI text -> Chinese (Simplified / Traditional). Keys match DOM
   textContent after collapsing whitespace (same normalization applied). */
var TABLES = {
"zh-Hans": {
 "Connection lost — retrying…": "连接已断开 — 正在重试…",
 "⚠️ 2026.14.x firmware enforcement active.": "⚠️ 2026.14.x 固件限制已生效。",
 "⚠️ IN-CAR AUTOPARK — CAN TX PAUSED": "⚠️ 车内自动泊车 — CAN 发送已暂停",
 "⚠️ OTA UPDATE IN PROGRESS — CAN TX SUSPENDED": "⚠️ OTA 更新进行中 — CAN 发送已挂起",
 "⚠️ Signal Map DAS id not seen on this bus.": "⚠️ 当前总线上未发现 Signal Map 的 DAS id。",
 "⚠️ Volatile storage — download events before power-off; they are lost on reboot.": "⚠️ 易失性存储 — 断电前请下载事件记录，重启后会丢失。",
 "— the standard parser can't read AP-state on this bus.": "— 标准解析器无法在此总线上读取 AP 状态。",
 "The configured DAS id isn't arriving, so AP-state can't be read and the nag killer is paused. Set": "配置的 DAS id 一直没有到来，无法读取 AP 状态，NAG 消除已暂停。设为",
 "for auto, or fix the mapping / tap.": "以自动检测，或修正映射 / 取线。",
 "Tesla added a preflight check in 2026.14.x that disables autosteer the moment any CAN frame touches": "特斯拉在 2026.14.x 加入了预检：任何 CAN 帧只要碰到以下帧即禁用自动转向：",
 ". Symptom on the dash:": "。仪表盘上的症状：",
 "\"Autopilot turning off\"": "\"Autopilot turning off\"",
 "Autopilot turning off": "Autopilot turning off",
 "appears within a second of stalk engagement, then AP immediately disengages. Listen-Only mode is safe.": "在拨动拨杆约一秒后出现，随后 AP 立即退出。仅监听模式是安全的。",
 "(delay injection until AP is engaged) is on the Flipper build only right now — on the ESP32, engage AP from the stalk first, then turn on injection. Dismiss if you're on pre-14.x firmware.": "（等 AP 启用后再延迟注入）目前仅 Flipper 版本支持 — 在 ESP32 上请先用拨杆启用 AP，再开启注入。如为 14.x 之前固件可忽略本提示。",
 "FSD Status": "FSD 状态",
 "AP Status": "AP 状态",
 "NAG Killer": "NAG 消除",
 "Controls": "控制",
 "CAN Bus": "CAN 总线",
 "Black-box": "黑匣子",
 "CAN Dump": "CAN 抓包",
 "HTTP CAN Log": "HTTP CAN 日志",
 "BMS Display": "BMS 显示",
 "WiFi Configuration": "WiFi 配置",
 "OTA Firmware Update": "OTA 固件更新",
 "SD Card": "SD 卡",
 "Storage": "存储",
 "Device": "设备",
 "Hardware": "硬件",
 "Firmware": "固件",
 "Activate": "激活",
 "Deactivate": "停用",
 "⚑ MARK NOW": "⚑ 立即标记",
 "RE-CHECK": "重新检测",
 "Tap Check": "取线检测",
 "SAVE & RESTART WIFI": "保存并重启 WiFi",
 "RESTART DEVICE": "重启设备",
 "Restart device?": "确定重启设备吗？",
 "The device will reboot immediately and the web connection will drop briefly.": "设备将立即重启，网页连接会短暂中断。",
 "Cancel": "取消",
 "Dismiss": "忽略",
 "Got it": "知道了",
 "Sign In": "登录",
 "Connect to WiFi": "连接 WiFi",
 "SELECT FIRMWARE (.bin)": "选择固件（.bin）",
 "Upload a .bin firmware file. Device will reboot after a successful update.": "上传 .bin 固件文件，更新成功后设备将重启。",
 "Error: Please select a .bin firmware file": "错误：请选择 .bin 固件文件",
 "STREAM LOG AND SAVE": "开始串流并保存",
 "Ready to collect a candump file in this browser.": "已就绪，可在此浏览器中采集 candump 文件。",
 "FORMAT SD CARD": "格式化 SD 卡",
 "DELETE ALL EVENTS": "删除全部事件",
 "Delete all recorded events from the device?": "确定删除设备上所有已记录的事件吗？",
 "No events recorded yet.": "暂无已记录的事件。",
 "Save mapping": "保存映射",
 "Apply this profile": "应用此配置",
 "Expand to setup": "展开设置",
 "Live": "Live",
 "Idle": "空闲",
 "Active": "已激活",
 "Disabled": "已禁用",
 "Off": "关闭",
 "No": "否",
 "Yes": "是",
 "NEW": "新增",
 "Ready": "就绪",
 "Recording": "录制中",
 "Streaming": "串流中",
 "Collecting": "采集中",
 "Preparing...": "准备中…",
 "Demo": "Demo",
 "Dev": "Dev",
 "Mode": "模式",
 "Listen-Only": "仅监听",
 "AP Branch/Tier (experimental)": "AP 分支/层级（实验性）",
 "Continuous AP": "持续 AP",
 "Force FSD": "强制 FSD",
 "FSD activate": "FSD 激活",
 "Force HW3": "强制 HW3",
 "Force HW4": "强制 HW4",
 "Force Legacy": "强制 Legacy",
 "China Mode": "中国模式",
 "Right-Hand Drive (RHD)": "右舵驾驶（RHD）",
 "RHD markets only — do NOT enable while driving on the right.": "仅限右舵市场 — 在靠右行驶地区行车时请勿启用。",
 "FSD Unlock": "FSD 解锁",
 "Summon EU Unlock": "欧盟版召唤解锁",
 "Track Mode (experimental)": "赛道模式（实验性）",
 "Compressor Overclock": "压缩机超频",
 "Post-drive Cooling": "停车后散热",
 "Precondition": "电池预处理",
 "battery preheat trigger (0x082)": "电池预热触发（0x082）",
 "max cooling": "最大制冷",
 "Continue on Green": "绿灯继续通行",
 "Suppress Chime": "屏蔽提示音",
 "Stability Assist": "稳定辅助",
 "Handling Balance": "操控平衡",
 "(stable → rotation)": "（稳定 → 旋转）",
 "Stealth Mode (Hidden)": "隐身模式（隐藏）",
 "Telemetry Off (experimental)": "关闭遥测（实验性）",
 "Soft Engage": "柔和启用",
 "Soft Engage (14.x, exp.)": "柔和启用（14.x，实验性）",
 "Instant Engage (exp.)": "即时启用（实验性）",
 "Minimal Inject (exp.)": "最小注入（实验性）",
 "AP-First": "AP 优先",
 "AP-First (14.x)": "AP 优先（14.x）",
 "Nag Burst (14.x, exp.)": "NAG 连发（14.x，实验性）",
 "Nag EPAS-faithful (14.x, exp.)": "NAG EPAS 高还原（14.x，实验性）",
 "Abort Guard (14.x, exp.)": "中断保护（14.x，实验性）",
 "TLSSC Restore": "TLSSC 恢复",
 "pairs with TLSSC": "与 TLSSC 联动",
 "Signal Map (advanced, 14.x)": "信号映射（高级，14.x）",
 "Override where the nag killer reads AP-state / hands-on / steering. Leave DAS id": "覆盖 NAG 消除读取 AP 状态 / 手握检测 / 转向信号的位置。DAS id 保持为 0 则",
 "DAS id (0x..)": "DAS id（0x..）",
 "Steer id (0x..)": "转向 id（0x..）",
 "Steer hi/lo byte": "转向高/低字节",
 "AP-state byte/sh/mask": "AP 状态 字节/位移/掩码",
 "Hands-on byte/sh/mask": "手握检测 字节/位移/掩码",
 "Auto-detect": "自动检测",
 "Auto-detect needs 0x398 — many Model 3/Y never send it. Pick your car if detection is wrong.": "自动检测需要 0x398 — 很多 Model 3/Y 从不发送该帧，若识别错误请手动选择车型。",
 "Best guess:": "最佳推测：",
 "— confirm in Service Mode → CAN Port": "— 请在 Service Mode → CAN Port 中确认",
 "for auto-detect. byte 0-7, shift 0-7, mask hex.": "用于自动检测。字节 0-7，位移 0-7，掩码为十六进制。",
 "Experimental & non-persistent — injects a UI branch/tier hint only, reverts when injection stops; unverified and may be a ban signal. Off by default.": "实验性且不持久 — 仅注入 UI 分支/层级提示，停止注入后恢复；未经验证，可能成为封禁依据。默认关闭。",
 "Experimental & unverified — clears reachable telemetry flags only (not the Vehicle-bus ECU log-upload). Does NOT guarantee reduced detection.": "实验性且未经验证 — 仅清除可达的遥测标记（不影响车辆总线 ECU 的日志上传），不保证降低被检测概率。",
 "Experimental — Vehicle-bus; not car-validated. Defaults to rear-biased (rotation 100) + 30% stability — fun with a safety margin. Raise stability for stock feel.": "实验性 — 车辆总线；未经实车验证。默认为偏后驱（rotation 100）+ 30% 稳定性 — 在安全余量内体验乐趣，提高稳定性可获得接近原厂的感受。",
 "CAN Errors": "CAN 错误",
 "CAN Vehicle": "车辆 CAN",
 "Dump Status": "抓包状态",
 "Filter IDs": "过滤 ID",
 "RX Frames": "接收帧",
 "TX Frames": "发送帧",
 "Frames/s": "帧/秒",
 "Dropped": "丢弃",
 "Buffered": "已缓冲",
 "Filtered": "已过滤",
 "0 frames": "0 帧",
 "frames / rx-missed": "帧 / 接收丢失",
 "No CAN frames collected. Nothing saved.": "未采集到 CAN 帧，未保存任何内容。",
 "No frames seen — check wiring / that the car is awake.": "未收到任何帧 — 请检查接线 / 确认车辆已唤醒。",
 "no 0x370 on this tap — wrong bus for the nag killer": "此接入点没有 0x370 — NAG 消除接错了总线",
 "HW unconfirmed — 0x399 reading assumed; verdict may change once HW is detected.": "硬件未确认 — 暂按 0x399 读数判断，硬件识别后结论可能变化。",
 "Looks like variant": "疑似变体",
 "Connect to run a check, or press Re-check.": "连接后运行检测，或点击重新检测。",
 "Listens a few seconds and reports whether each feature can work on the bus this device is tapped into. Pure read-only — nothing is transmitted.": "监听数秒，报告各功能在当前接入总线上是否可用。纯只读 — 不发送任何数据。",
 "No CAN Traffic": "无 CAN 流量",
 "Body/comfort bus": "车身/舒适总线",
 "DAS state readable": "DAS 状态可读",
 "Records the key diagnostic CAN IDs around anomalies (aborts, bus-off, manual marks) to the device only — never uploaded. Use the toggle below to enable or disable.": "仅在设备本地记录异常（中断、bus-off、手动标记）前后的关键诊断 CAN ID — 永不上传。用下方开关启用或禁用。",
 "Auto-record": "自动录制",
 "HTTP CAN log is available only in Listen-Only mode.": "HTTP CAN 日志仅在仅监听模式下可用。",
 "Switch to Listen-Only mode before starting HTTP CAN log.": "启动 HTTP CAN 日志前，请先切换到仅监听模式。",
 "Log ready in phone memory:": "日志已就绪（手机内存）：",
 "Save/share requested for": "已请求保存/分享：",
 "Share cancelled or failed:": "分享已取消或失败：",
 "Server response:": "服务器响应：",
 "This browser does not support HTTP stream collection.": "此浏览器不支持 HTTP 串流采集。",
 ". Trying download link...": "。正在尝试下载链接…",
 "Connecting to HTTP stream...": "正在连接 HTTP 串流…",
 "connection closed": "连接已关闭",
 "Stream stopped:": "串流已停止：",
 "The device starts its own access point by default. Optionally set a network below; when a network name is set, the device tries to connect to it on boot and starts its own access point if it cannot connect.": "设备默认会启动自带热点。也可在下方设置网络；设置网络名称后，设备启动时会优先连接该网络，失败则回退到自带热点。",
 "Network Name": "网络名称",
 "Network Password": "网络密码",
 "Password": "密码",
 "Access Point": "接入点",
 "Enter the admin username and the WiFi AP password.": "请输入管理员用户名和 WiFi 热点密码。",
 "Authentication Required": "需要身份验证",
 "Username": "用户名",
 "Authentication failed": "身份验证失败",
 "Authorization": "授权",
 "No OTA Partition": "无 OTA 分区",
 "No OTA partition": "无 OTA 分区",
 "OTA Partition": "OTA 分区",
 "Partition Safety": "分区安全",
 "Ignore OTA": "忽略 OTA",
 "Deep Sleep (sec)": "深度睡眠（秒）",
 "Display Brightness (%)": "显示亮度（%）",
 "Display Timeout (s)": "显示超时（秒）",
 "Administration": "管理",
 "Voltage": "电压",
 "Current": "电流",
 "Temp": "温度",
 "SOC": "电量",
 "Battery": "电池",
 "Uptime": "运行时间",
 "BMS Frames": "BMS 帧",
 "BMS Status": "BMS 状态",
 "Free & open source ·": "免费开源 ·",
 "ESP32 CAN Controller ·": "ESP32 CAN 控制器 ·",
 "support the research": "支持本研究",
 "mirror read-back": "镜像回读",
 "optional": "可选",
 "default": "默认",
 "single": "单路",
 "dual-CAN": "双路 CAN",
 "Legacy": "Legacy",
 "del": "删除",
 "Status": "状态",
 "State": "状态",
 "Stream": "串流",
 "Stage": "Stage",
 "Stage2": "Stage2",
 "Listening on the bus…": "正在监听总线…",
 "Reachable frames:": "可达帧：",
 "(presence only — not proof injection actuates them).": "（仅表示存在 — 不能证明注入能实际生效）。",
 "Waiting Frames": "等待帧",
 "Waiting": "等待中",
 "Capturing": "记录中",
 "Armed": "待命",
 "Detected": "已检测到",
 "Listening…": "监听中…",
 "Done": "完成",
 "ON": "开",
 "OFF": "关",
 "Device restart triggered": "已触发设备重启",
 "Network password must be empty or 8+ chars": "网络密码须为空或 8 位以上",
 "Password must be empty or 8+ chars": "密码须为空或 8 位以上",
 "SSID required": "需要填写 SSID",
 "OTA writes to the next app partition when available. The new image is kept only after 15 s of runtime; a crash or power cut before that restores the previous firmware. Keep USB reflashing available as a recovery path.": "OTA 会在可用时写入下一个 app 分区；新固件需连续运行 15 秒后才会被保留，在此之前崩溃或断电会回滚到上一版固件。请保留 USB 线刷作为恢复手段。",
 "WiFi Clients": "WiFi 客户端"
},
"zh-Hant": {
 "Connection lost — retrying…": "連線已中斷 — 正在重試…",
 "⚠️ 2026.14.x firmware enforcement active.": "⚠️ 2026.14.x 韌體限制已生效。",
 "⚠️ IN-CAR AUTOPARK — CAN TX PAUSED": "⚠️ 車內自動停車 — CAN 傳送已暫停",
 "⚠️ OTA UPDATE IN PROGRESS — CAN TX SUSPENDED": "⚠️ OTA 更新進行中 — CAN 傳送已暫停",
 "⚠️ Signal Map DAS id not seen on this bus.": "⚠️ 在此匯流排上未發現 Signal Map 的 DAS id。",
 "⚠️ Volatile storage — download events before power-off; they are lost on reboot.": "⚠️ 揮發性儲存 — 斷電前請下載事件記錄，重新開機後將遺失。",
 "— the standard parser can't read AP-state on this bus.": "— 標準解析器無法在此匯流排上讀取 AP 狀態。",
 "The configured DAS id isn't arriving, so AP-state can't be read and the nag killer is paused. Set": "設定的 DAS id 一直沒有出現，無法讀取 AP 狀態，NAG 消除已暫停。設為",
 "for auto, or fix the mapping / tap.": "以自動偵測，或修正映射 / 接線。",
 "Tesla added a preflight check in 2026.14.x that disables autosteer the moment any CAN frame touches": "特斯拉在 2026.14.x 加入了預檢：任何 CAN 訊框只要碰到以下訊框即停用自動轉向：",
 ". Symptom on the dash:": "。儀表板上的症狀：",
 "\"Autopilot turning off\"": "\"Autopilot turning off\"",
 "Autopilot turning off": "Autopilot turning off",
 "appears within a second of stalk engagement, then AP immediately disengages. Listen-Only mode is safe.": "在撥動撥桿約一秒後出現，隨後 AP 立即退出。僅監聽模式是安全的。",
 "(delay injection until AP is engaged) is on the Flipper build only right now — on the ESP32, engage AP from the stalk first, then turn on injection. Dismiss if you're on pre-14.x firmware.": "（等 AP 啟用後再延遲注入）目前僅 Flipper 版本支援 — 在 ESP32 上請先用撥桿啟用 AP，再開啟注入。若為 14.x 之前韌體可忽略本提示。",
 "FSD Status": "FSD 狀態",
 "AP Status": "AP 狀態",
 "NAG Killer": "NAG 消除",
 "Controls": "控制",
 "CAN Bus": "CAN 匯流排",
 "Black-box": "黑盒子",
 "CAN Dump": "CAN 側錄",
 "HTTP CAN Log": "HTTP CAN 日誌",
 "BMS Display": "BMS 顯示",
 "WiFi Configuration": "WiFi 設定",
 "OTA Firmware Update": "OTA 韌體更新",
 "SD Card": "SD 卡",
 "Storage": "儲存空間",
 "Device": "裝置",
 "Hardware": "硬體",
 "Firmware": "韌體",
 "Activate": "啟用",
 "Deactivate": "停用",
 "⚑ MARK NOW": "⚑ 立即標記",
 "RE-CHECK": "重新檢測",
 "Tap Check": "接線檢查",
 "SAVE & RESTART WIFI": "儲存並重啟 WiFi",
 "RESTART DEVICE": "重啟裝置",
 "Restart device?": "確定要重啟裝置嗎？",
 "The device will reboot immediately and the web connection will drop briefly.": "裝置將立即重啟，網頁連線會短暫中斷。",
 "Cancel": "取消",
 "Dismiss": "忽略",
 "Got it": "知道了",
 "Sign In": "登入",
 "Connect to WiFi": "連接 WiFi",
 "SELECT FIRMWARE (.bin)": "選擇韌體（.bin）",
 "Upload a .bin firmware file. Device will reboot after a successful update.": "上傳 .bin 韌體檔案，更新成功後裝置將重啟。",
 "Error: Please select a .bin firmware file": "錯誤：請選擇 .bin 韌體檔案",
 "STREAM LOG AND SAVE": "開始串流並儲存",
 "Ready to collect a candump file in this browser.": "已就緒，可在此瀏覽器中擷取 candump 檔案。",
 "FORMAT SD CARD": "格式化 SD 卡",
 "DELETE ALL EVENTS": "刪除全部事件",
 "Delete all recorded events from the device?": "確定刪除裝置上所有已記錄的事件嗎？",
 "No events recorded yet.": "尚無已記錄的事件。",
 "Save mapping": "儲存映射",
 "Apply this profile": "套用此設定檔",
 "Expand to setup": "展開設定",
 "Live": "Live",
 "Idle": "閒置",
 "Active": "已啟用",
 "Disabled": "已停用",
 "Off": "關閉",
 "No": "否",
 "Yes": "是",
 "NEW": "新增",
 "Ready": "就緒",
 "Recording": "錄製中",
 "Streaming": "串流中",
 "Collecting": "擷取中",
 "Preparing...": "準備中…",
 "Demo": "Demo",
 "Dev": "Dev",
 "Mode": "模式",
 "Listen-Only": "僅監聽",
 "AP Branch/Tier (experimental)": "AP 分支/層級（實驗性）",
 "Continuous AP": "持續 AP",
 "Force FSD": "強制 FSD",
 "FSD activate": "FSD 啟用",
 "Force HW3": "強制 HW3",
 "Force HW4": "強制 HW4",
 "Force Legacy": "強制 Legacy",
 "China Mode": "中國模式",
 "Right-Hand Drive (RHD)": "右駕（RHD）",
 "RHD markets only — do NOT enable while driving on the right.": "僅限右駕市場 — 在靠右行駛地區行車時請勿啟用。",
 "FSD Unlock": "FSD 解鎖",
 "Summon EU Unlock": "歐盟版召喚解鎖",
 "Track Mode (experimental)": "賽道模式（實驗性）",
 "Compressor Overclock": "壓縮機超頻",
 "Post-drive Cooling": "停車後散熱",
 "Precondition": "電池預處理",
 "battery preheat trigger (0x082)": "電池預熱觸發（0x082）",
 "max cooling": "最大冷卻",
 "Continue on Green": "綠燈繼續通行",
 "Suppress Chime": "關閉提示音",
 "Stability Assist": "穩定輔助",
 "Handling Balance": "操控平衡",
 "(stable → rotation)": "（穩定 → 旋轉）",
 "Stealth Mode (Hidden)": "隱身模式（隱藏）",
 "Telemetry Off (experimental)": "關閉遙測（實驗性）",
 "Soft Engage": "柔和啟用",
 "Soft Engage (14.x, exp.)": "柔和啟用（14.x，實驗性）",
 "Instant Engage (exp.)": "即時啟用（實驗性）",
 "Minimal Inject (exp.)": "最小注入（實驗性）",
 "AP-First": "AP 優先",
 "AP-First (14.x)": "AP 優先（14.x）",
 "Nag Burst (14.x, exp.)": "NAG 連發（14.x，實驗性）",
 "Nag EPAS-faithful (14.x, exp.)": "NAG EPAS 高還原（14.x，實驗性）",
 "Abort Guard (14.x, exp.)": "中斷保護（14.x，實驗性）",
 "TLSSC Restore": "TLSSC 還原",
 "pairs with TLSSC": "與 TLSSC 連動",
 "Signal Map (advanced, 14.x)": "訊號映射（進階，14.x）",
 "Override where the nag killer reads AP-state / hands-on / steering. Leave DAS id": "覆寫 NAG 消除讀取 AP 狀態 / 手握偵測 / 轉向訊號的位置。DAS id 保持為 0 則",
 "DAS id (0x..)": "DAS id（0x..）",
 "Steer id (0x..)": "轉向 id（0x..）",
 "Steer hi/lo byte": "轉向高/低位元組",
 "AP-state byte/sh/mask": "AP 狀態 位元組/位移/遮罩",
 "Hands-on byte/sh/mask": "手握偵測 位元組/位移/遮罩",
 "Auto-detect": "自動偵測",
 "Auto-detect needs 0x398 — many Model 3/Y never send it. Pick your car if detection is wrong.": "自動偵測需要 0x398 — 許多 Model 3/Y 從不傳送該訊框，若辨識錯誤請手動選擇車型。",
 "Best guess:": "最佳推測：",
 "— confirm in Service Mode → CAN Port": "— 請至 Service Mode → CAN Port 確認",
 "for auto-detect. byte 0-7, shift 0-7, mask hex.": "用於自動偵測。位元組 0-7，位移 0-7，遮罩為十六進位。",
 "Experimental & non-persistent — injects a UI branch/tier hint only, reverts when injection stops; unverified and may be a ban signal. Off by default.": "實驗性且不持久 — 僅注入 UI 分支/層級提示，停止注入後還原；未經驗證，可能成為停權依據。預設關閉。",
 "Experimental & unverified — clears reachable telemetry flags only (not the Vehicle-bus ECU log-upload). Does NOT guarantee reduced detection.": "實驗性且未經驗證 — 僅清除可觸及的遙測旗標（不影響車輛匯流排 ECU 的日誌上傳），不保證降低被偵測機率。",
 "Experimental — Vehicle-bus; not car-validated. Defaults to rear-biased (rotation 100) + 30% stability — fun with a safety margin. Raise stability for stock feel.": "實驗性 — 車輛匯流排；未經實車驗證。預設為偏後驅（rotation 100）+ 30% 穩定性 — 在安全餘裕內體驗樂趣，提高穩定性可獲得接近原廠的感受。",
 "CAN Errors": "CAN 錯誤",
 "CAN Vehicle": "車輛 CAN",
 "Dump Status": "擷取狀態",
 "Filter IDs": "過濾 ID",
 "RX Frames": "接收訊框",
 "TX Frames": "傳送訊框",
 "Frames/s": "訊框/秒",
 "Dropped": "丟棄",
 "Buffered": "已緩衝",
 "Filtered": "已過濾",
 "0 frames": "0 訊框",
 "frames / rx-missed": "訊框 / 接收遺失",
 "No CAN frames collected. Nothing saved.": "未擷取到 CAN 訊框，未儲存任何內容。",
 "No frames seen — check wiring / that the car is awake.": "未收到任何訊框 — 請檢查接線 / 確認車輛已喚醒。",
 "no 0x370 on this tap — wrong bus for the nag killer": "此接線點沒有 0x370 — NAG 消除接錯了匯流排",
 "HW unconfirmed — 0x399 reading assumed; verdict may change once HW is detected.": "硬體未確認 — 暫按 0x399 讀數判斷，硬體辨識後結論可能改變。",
 "Looks like variant": "疑似變體",
 "Connect to run a check, or press Re-check.": "連接後執行檢測，或按重新檢測。",
 "Listens a few seconds and reports whether each feature can work on the bus this device is tapped into. Pure read-only — nothing is transmitted.": "監聽數秒，報告各功能在目前接入匯流排上是否可用。純唯讀 — 不傳送任何資料。",
 "No CAN Traffic": "無 CAN 流量",
 "Body/comfort bus": "車身/舒適匯流排",
 "DAS state readable": "DAS 狀態可讀",
 "Records the key diagnostic CAN IDs around anomalies (aborts, bus-off, manual marks) to the device only — never uploaded. Use the toggle below to enable or disable.": "僅在裝置本機記錄異常（中斷、bus-off、手動標記）前後的關鍵診斷 CAN ID — 永不上傳。用下方開關啟用或停用。",
 "Auto-record": "自動錄製",
 "HTTP CAN log is available only in Listen-Only mode.": "HTTP CAN 日誌僅在僅監聽模式下可用。",
 "Switch to Listen-Only mode before starting HTTP CAN log.": "啟動 HTTP CAN 日誌前，請先切換到僅監聽模式。",
 "Log ready in phone memory:": "日誌已就緒（手機記憶體）：",
 "Save/share requested for": "已要求儲存/分享：",
 "Share cancelled or failed:": "分享已取消或失敗：",
 "Server response:": "伺服器回應：",
 "This browser does not support HTTP stream collection.": "此瀏覽器不支援 HTTP 串流擷取。",
 ". Trying download link...": "。正在嘗試下載連結…",
 "Connecting to HTTP stream...": "正在連接 HTTP 串流…",
 "connection closed": "連線已關閉",
 "Stream stopped:": "串流已停止：",
 "The device starts its own access point by default. Optionally set a network below; when a network name is set, the device tries to connect to it on boot and starts its own access point if it cannot connect.": "裝置預設會啟動自帶熱點。也可在下方設定網路；設定網路名稱後，裝置啟動時會優先連接該網路，失敗則退回自帶熱點。",
 "Network Name": "網路名稱",
 "Network Password": "網路密碼",
 "Password": "密碼",
 "Access Point": "存取點",
 "Enter the admin username and the WiFi AP password.": "請輸入管理員使用者名稱和 WiFi 熱點密碼。",
 "Authentication Required": "需要驗證",
 "Username": "使用者名稱",
 "Authentication failed": "驗證失敗",
 "Authorization": "授權",
 "No OTA Partition": "無 OTA 分割區",
 "No OTA partition": "無 OTA 分割區",
 "OTA Partition": "OTA 分割區",
 "Partition Safety": "分割區安全",
 "Ignore OTA": "忽略 OTA",
 "Deep Sleep (sec)": "深層睡眠（秒）",
 "Display Brightness (%)": "顯示器亮度（%）",
 "Display Timeout (s)": "顯示逾時（秒）",
 "Administration": "管理",
 "Voltage": "電壓",
 "Current": "電流",
 "Temp": "溫度",
 "SOC": "電量",
 "Battery": "電池",
 "Uptime": "運行時間",
 "BMS Frames": "BMS 訊框",
 "BMS Status": "BMS 狀態",
 "Free & open source ·": "免費開源 ·",
 "ESP32 CAN Controller ·": "ESP32 CAN 控制器 ·",
 "support the research": "支持本研究",
 "mirror read-back": "鏡像回讀",
 "optional": "選填",
 "default": "預設",
 "single": "單路",
 "dual-CAN": "雙路 CAN",
 "Legacy": "Legacy",
 "del": "刪除",
 "Status": "狀態",
 "State": "狀態",
 "Stream": "串流",
 "Stage": "Stage",
 "Stage2": "Stage2",
 "Listening on the bus…": "正在監聽匯流排…",
 "Reachable frames:": "可達訊框：",
 "(presence only — not proof injection actuates them).": "（僅表示存在 — 不能證明注入能實際生效）。",
 "Waiting Frames": "等待訊框",
 "Waiting": "等待中",
 "Capturing": "記錄中",
 "Armed": "待命",
 "Detected": "已偵測到",
 "Listening…": "監聽中…",
 "Done": "完成",
 "ON": "開",
 "OFF": "關",
 "Device restart triggered": "已觸發裝置重啟",
 "Network password must be empty or 8+ chars": "網路密碼須為空或 8 位以上",
 "Password must be empty or 8+ chars": "密碼須為空或 8 位以上",
 "SSID required": "需要填寫 SSID",
 "OTA writes to the next app partition when available. The new image is kept only after 15 s of runtime; a crash or power cut before that restores the previous firmware. Keep USB reflashing available as a recovery path.": "OTA 會在可用時寫入下一個 app 分割區；新韌體需連續執行 15 秒後才會被保留，在此之前當機或斷電會還原到上一版韌體。請保留 USB 線刷作為還原手段。",
 "WiFi Clients": "WiFi 客戶端"
}
};

var LS_KEY = "teslaFsdLang";
var LANGS = ["en", "zh-Hans", "zh-Hant"];
var HTML_LANG = {"en": "en", "zh-Hans": "zh-CN", "zh-Hant": "zh-Hant"};
var BTN_LABEL = {"en": "EN", "zh-Hans": "简体", "zh-Hant": "繁體"};

function detectLang(tag){
  var l = String(tag || "").toLowerCase().replace(/_/g, "-");
  if(!/^zh(-|$)/.test(l)) return "en";
  if(/^zh-(hant|tw|hk|mo)(-|$)/.test(l)) return "zh-Hant";
  return "zh-Hans";
}

var lang = "en";
var DICT = {};
var KEYS = [];

function setDict(){
  DICT = (lang === "en") ? {} : (TABLES[lang] || {});
  KEYS = Object.keys(DICT).sort(function(a,b){ return b.length - a.length; });
}

function setLang(l){
  lang = l;
  setDict();
  try{ if(document.documentElement) document.documentElement.lang = HTML_LANG[l] || "en"; }catch(e){}
}

function norm(s){ return String(s == null ? "" : s).replace(/\s+/g, " ").trim(); }

function zhText(raw){
  var n = norm(raw);
  if(!n) return null;
  if(Object.prototype.hasOwnProperty.call(DICT, n)) return DICT[n];
  var i, k, tail, out, j, s2, head;
  // Longest-prefix match for templated strings, e.g. "Best guess: <dynamic>".
  for(i = 0; i < KEYS.length; i++){
    k = KEYS[i];
    if(k.length < 6 || n.indexOf(k) !== 0) continue;
    tail = n.slice(k.length);
    if(tail !== "" && /[A-Za-z0-9]/.test(tail.charAt(0))) continue; // word boundary
    out = DICT[k] + tail;
    // Suffix match on the remainder, e.g. "... -- confirm in Service Mode".
    for(j = 0; j < KEYS.length; j++){
      s2 = KEYS[j];
      if(s2.length < 6 || out.length <= s2.length) continue;
      if(out.slice(-s2.length) !== s2) continue;
      head = out.slice(0, out.length - s2.length);
      if(/[A-Za-z0-9]/.test(head.charAt(head.length - 1)) && /[A-Za-z0-9]/.test(s2.charAt(0))) continue;
      out = head + DICT[s2];
      break;
    }
    return out;
  }
  return null;
}

var SKIP_TAGS = {SCRIPT:1, STYLE:1, TEXTAREA:1, NOSCRIPT:1, CODE:1, PRE:1};
var ATTR_NAMES = ["placeholder", "title", "aria-label", "alt"];

function translateTextNode(node){
  var t = zhText(node.nodeValue);
  if(t !== null && t !== node.nodeValue) node.nodeValue = t;
}

function translateElement(el){
  var i, a, v, t;
  if(!el.getAttribute) return;
  for(i = 0; i < ATTR_NAMES.length; i++){
    a = ATTR_NAMES[i];
    v = el.getAttribute(a);
    if(v){
      t = zhText(v);
      if(t !== null && t !== v) el.setAttribute(a, t);
    }
  }
}

function walk(root){
  var els, i, n, walker;
  if(root.querySelectorAll){
    els = root.querySelectorAll("*");
    for(i = 0; i < els.length; i++) translateElement(els[i]);
  }
  if(root.nodeType === 1) translateElement(root);
  walker = document.createTreeWalker(root, NodeFilter.SHOW_TEXT, {
    acceptNode: function(node){
      var p = node.parentElement;
      if(p && SKIP_TAGS[p.tagName]) return NodeFilter.FILTER_REJECT;
      return NodeFilter.FILTER_ACCEPT;
    }
  });
  while((n = walker.nextNode())) translateTextNode(n);
}

function currentIsZh(){ return lang !== "en"; }

// Translate native dialogs (alert/confirm) issued by the page's own script.
(function(){
  if(window.__i18nAlertWrapped) return;
  window.__i18nAlertWrapped = true;
  var _alert = window.alert ? window.alert.bind(window) : null;
  var _confirm = window.confirm ? window.confirm.bind(window) : null;
  if(_alert) window.alert = function(msg){ _alert(currentIsZh() ? (zhText(msg) || msg) : msg); };
  if(_confirm) window.confirm = function(msg){ return _confirm(currentIsZh() ? (zhText(msg) || msg) : msg); };
})();

function applyLang(){
  if(!currentIsZh() || !document.documentElement) return;
  walk(document.documentElement);
}

try{
  var saved = window.localStorage.getItem(LS_KEY);
  if(saved === "zh") saved = "zh-Hans";  // migrate the old two-way value
  if(saved === "en" || saved === "zh-Hans" || saved === "zh-Hant"){ setLang(saved); }
  else { setLang(detectLang(navigator.language || navigator.userLanguage)); }
}catch(e){ setLang("en"); }

var btn = document.createElement("button");
btn.id = "langToggle";
btn.type = "button";
function paintBtn(){ btn.textContent = BTN_LABEL[lang] || "EN"; }
paintBtn();
btn.style.cssText = "position:absolute;left:0;top:26px;z-index:50;background:rgba(0,212,170,.12);"
  + "border:1px solid rgba(0,212,170,.45);color:#00d4aa;font-size:.72em;font-weight:700;"
  + "padding:5px 10px;border-radius:20px;cursor:pointer;letter-spacing:.05em";
btn.setAttribute("aria-label", "Switch language / 切换语言 / 切換語言");
btn.onclick = function(){
  var from = lang;
  var i = LANGS.indexOf(lang);
  setLang(LANGS[(i + 1) % LANGS.length]);
  try{ window.localStorage.setItem(LS_KEY, lang); }catch(e){}
  paintBtn();
  if(from === "en" && currentIsZh()){ applyLang(); }
  else { window.location.reload(); }
};

function mount(){
  var hdr = document.querySelector(".hdr");
  if(hdr){ hdr.appendChild(btn); }
  else if(document.body){ document.body.insertBefore(btn, document.body.firstChild); }
  applyLang();
}

if(document.readyState === "loading"){
  document.addEventListener("DOMContentLoaded", mount);
} else {
  mount();
}

// Translate WebSocket-driven live updates as they land in the DOM.
if("MutationObserver" in window){
  var mo = new MutationObserver(function(muts){
    var i, j, m, added, nd;
    if(!currentIsZh()) return;
    for(i = 0; i < muts.length; i++){
      m = muts[i];
      if(m.type === "characterData"){ translateTextNode(m.target); }
      else{
        added = m.addedNodes;
        for(j = 0; j < added.length; j++){
          nd = added[j];
          if(nd.nodeType === 3){ translateTextNode(nd); }
          else if(nd.nodeType === 1){ walk(nd); }
        }
      }
    }
  });
  var startWatch = function(){
    if(document.documentElement) mo.observe(document.documentElement,
      {childList: true, subtree: true, characterData: true});
  };
  if(document.readyState === "loading"){
    document.addEventListener("DOMContentLoaded", startWatch);
  } else {
    startWatch();
  }
}
})();
</script>
)rawliteral"
